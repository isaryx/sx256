## config/boards/shields/sx_256/Kconfig.shield
```kconfig
config SHIELD_XIAO_256_LEFT
    def_bool $(shields_list_contains,sx_256_left)

config SHIELD_XIAO_256_RIGHT
    def_bool $(shields_list_contains,sx_256_right)
```
