## config/boards/shields/xiao_256/Kconfig.defconfig
```kconfig
if SHIELD_XIAO_256_LEFT

config ZMK_KEYBOARD_NAME
    default "xiao256"

config ZMK_SPLIT_ROLE_CENTRAL
    default y

endif

if SHIELD_XIAO_256_LEFT || SHIELD_XIAO_256_RIGHT

config ZMK_SPLIT
    default y

endif
```

## config/boards/shields/xiao_256/Kconfig.shield
```kconfig
config SHIELD_XIAO_256_LEFT
    def_bool $(shields_list_contains,xiao_256_left)

config SHIELD_XIAO_256_RIGHT
    def_bool $(shields_list_contains,xiao_256_right)
```
